## ext-tree/Config.in
```kconfig
source "$BR2_EXTERNAL_AESD_ASSIGNMENTS_PATH/package/aesd-assignments-socket/Config.in"
source "$BR2_EXTERNAL_AESD_ASSIGNMENTS_PATH/package/aesd-assignments-modules/Config.in"
# source "$BR2_EXTERNAL_AESD_ASSIGNMENTS_PATH/package/myopenssl/Config.in"
```

## ext-tree/configs/aesd-board_defconfig
```kconfig
BR2_LINUX_KERNEL_CUSTOM_CONFIG_FILE="$(BR2_EXTERNAL_AESD_ASSIGNMENTS_PATH)/kernel.config"
BR2_ROOTFS_OVERLAY="$(BR2_EXTERNAL_AESD_ASSIGNMENTS_PATH)/overlay/"
BR2_ROOTFS_DEVICE_TABLE="$(BR2_EXTERNAL_AESD_ASSIGNMENTS_PATH)/system/my_device_table.txt"
```

## ext-tree/package/aesd-assignments-devices/Config.in
```kconfig
config BR2_PACKAGE_AESD_ASSIGNMENTS_DEVICES
	bool "aesd-assignments-devices"
	help
	  aesd kernel device assignment
```

## ext-tree/package/aesd-assignments-modules/Config.in
```kconfig
config BR2_PACKAGE_AESD_ASSIGNMENTS_MODULES
	bool "aesd-assignments-modules"
	help
	  aesd kernel module assignment
```

## ext-tree/package/aesd-assignments-socket/Config.in
```kconfig
config BR2_PACKAGE_AESD_ASSIGNMENTS_SOCKET
	bool "aesd-assignments-socket"
	help
	  AESD socket assignment.
```
